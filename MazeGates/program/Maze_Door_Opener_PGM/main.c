/******************************************************************************/
/**********              File:  maze door opener.c             ****************/
/**********     Author: Lee Embray, Heidelberg Universität     ****************/
/**********  Physiology und Pathophysiology abteilung          ****************/
/**********           Created on 16. October 2017,             ****************/
/******************************************************************************/

/******************************************************************************/
/********************************* DEFINE *************************************/
/******************************************************************************/
#define TRIGin RB0                                                              // TRIGGER INPUT
#define SERVO1 RC3                                                            // SERVO OUTPUT 
#define LED1 RC7                                                                // LED OUTPUT 
/******************************************************************************/
/******************************** INCLUDE *************************************/
/******************************************************************************/
#include "mcc_generated_files/mcc.h"
#include "lcd.h"
#include <stdio.h>
#include <time.h>
#include <stdlib.h>
/******************************************************************************/
/************************** DEFINE VARIABLES **********************************/
/******************************************************************************/
unsigned int mincount;
unsigned int maxcount;
/**************************** FUNCTION ****************************************/
/************************** DELAY 200mS ***************************************/
/******************************************************************************/
void delay2(void)                                                                // function for 200mS delay
{
    __delay_ms(100);
    __delay_ms(100);
}
/**************************** FUNCTION ****************************************/
/************************** DELAY 500mS ***************************************/
/******************************************************************************/
void delay5(void)                                                               // function for 500mS delay
{
    __delay_ms(100);
    __delay_ms(100);
    __delay_ms(100);
    __delay_ms(100);
    __delay_ms(100);
}
/**************************** FUNCTION ****************************************/
/****************************** MIN *******************************************/
/******************************************************************************/
void MIN(void)
{
while(TRIGin == 0)
    {
    LED1 = 0;
    if(TRIGin == 0 && mincount != 0)
        {
        SERVO1 = 1;
        __delay_us(960);                                                        // This number sets the minimum position of the servo
        SERVO1 = 0;
        __delay_ms(3);
        mincount = mincount-1;
        }

    }
} 
/**************************** FUNCTION ****************************************/
/****************************** MAX *******************************************/
/******************************************************************************/
void MAX(void)
{
while(TRIGin == 1)
    {
    LED1 = 1;
    if(TRIGin == 1 && maxcount != 0)
        {
        SERVO1 = 1;
        __delay_us(2000);                                                       // This number sets the minimum position of the servo
        SERVO1 = 0;
        __delay_ms(3);
        maxcount = maxcount-1;
        }

    }
} 
/******************************************************************************/
/******************** MAIN PROGRAM STARTS RUNNING HERE ************************/
/******************************************************************************/
void main(void)                                                                 // start of main program
{ 
SYSTEM_Initialize();                                                            // Initialize the device                                                            
/******************************************************************************/
/**************************** MAIN PROGRAM ************************************/
/******************************************************************************/ 

LED1 = 1;
__delay_ms(100);
LED1 = 0;
__delay_ms(100);
LED1 = 1;
__delay_ms(100);
LED1 = 0;
__delay_ms(100);
LED1 = 1;
__delay_ms(100);
LED1 = 0;
__delay_ms(100);
LED1 = 1;
__delay_ms(100);
LED1 = 0;
__delay_ms(100);

while (1)
    {
    mincount = 100;
    maxcount = 100;
    if(TRIGin != 1)
        MIN();        
    if(TRIGin == 1)   
        MAX();
    } 
}
